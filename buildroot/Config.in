## buildroot/Config.in
```kconfig
menu "PU2PNY-V2 packages"
source "$BR2_EXTERNAL_PU2PNY_V2_PATH/package/pu2pny-mmdvm-host/Config.in"
source "$BR2_EXTERNAL_PU2PNY_V2_PATH/package/pu2pny-mmdvm-display/Config.in"
source "$BR2_EXTERNAL_PU2PNY_V2_PATH/package/pu2pny-nextiondriver/Config.in"
endmenu
```

## buildroot/package/pu2pny-mmdvm-display/Config.in
```kconfig
config BR2_PACKAGE_PU2PNY_MMDVM_DISPLAY
	bool "MMDVM-Display"
	depends on BR2_INSTALL_LIBSTDCPP
	depends on BR2_TOOLCHAIN_GCC_AT_LEAST_4_9
	depends on BR2_TOOLCHAIN_HAS_THREADS
	depends on BR2_PACKAGE_MOSQUITTO
	select BR2_PACKAGE_JSON_FOR_MODERN_CPP
	help
	  Build the pinned MMDVM-Display binary for the existing display
	  chain. NextionDriver and service configuration are separate.
```

## buildroot/package/pu2pny-mmdvm-host/Config.in
```kconfig
config BR2_PACKAGE_PU2PNY_MMDVM_HOST
	bool "MMDVM-Host"
	depends on BR2_INSTALL_LIBSTDCPP
	depends on BR2_TOOLCHAIN_GCC_AT_LEAST_7
	depends on BR2_TOOLCHAIN_HAS_THREADS
	depends on BR2_PACKAGE_MOSQUITTO
	select BR2_PACKAGE_JSON_FOR_MODERN_CPP
	help
	  Build the pinned MMDVM-Host RF binary. Hotspot configuration
	  and service activation are managed separately.
```

## buildroot/package/pu2pny-nextiondriver/Config.in
```kconfig
config BR2_PACKAGE_PU2PNY_NEXTIONDRIVER
	bool "NextionDriver ON7LDS (PU2PNY)"
	help
	  Build the hardened ON7LDS serial display driver. It does not
	  enable the service or write display firmware.
```
